/include/ "system-conf.dtsi"
/ {
};

&PS_PL_communication_axi_bram_ctrl_rec {
	compatible = "xlnx,axi-bram-ctrl-receive";
};

&PS_PL_communication_axi_bram_ctrl_send {
	compatible = "xlnx,axi-bram-ctrl-send";
};

&PS_PL_communication_axi_bram_ctrl_status {
	compatible = "xlnx,axi-bram-ctrl-status";
};

