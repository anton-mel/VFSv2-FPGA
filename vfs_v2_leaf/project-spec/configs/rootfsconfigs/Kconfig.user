## vfs_v2_leaf/project-spec/configs/rootfsconfigs/Kconfig.user
```kconfig
menu "user packages " 
config datagenerator  
	 bool "datagenerator"
	 help
	
config gpio-demo  
	 bool "gpio-demo"
	 help
	
config leaf-driver  
	 bool "leaf-driver"
	 help
	
config peekpoke  
	 bool "peekpoke"
	 help
	
endmenu
```

## vfs_v2_root/project-spec/configs/configs/Kconfig
```kconfig
mainmenu "PetaLinux System Configuration"
config SUBSYSTEM_TYPE_LINUX
        bool
        default y
        select SYSTEM_VERSAL

config SYSTEM_VERSAL
        bool "VERSAL Configuration"
        help
          VERSAL Configuration for petalinux project.
          All these config options will be in /home/helios/Petalinux/vfs_v2/vfs_v2_root/project-spec/configs/config

config SUBSYSTEM_VARIANT_VERSALPRIME
        bool
        default y
        help

config SUBSYSTEM_DISTRO_PETALINUX
        bool
        default y
        help

source /home/helios/Petalinux/vfs_v2/vfs_v2_root/project-spec/configs/configs/Kconfig.main
```

## vfs_v2_root/project-spec/configs/rootfsconfigs/Kconfig.user
```kconfig
menu "user packages " 
config gpio-demo  
	 bool "gpio-demo"
	 help
	
config peekpoke  
	 bool "peekpoke"
	 help
	
config root-driver  
	 bool "root-driver"
	 help
	
endmenu
```
